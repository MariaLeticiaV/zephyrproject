## zephyr/hello_timer_activity/Kconfig
```kconfig
menu "Hello Timer Configuration"

config HELLO_TIMER_INTERVAL_MS
    int "Hello World Timer Interval (ms)"
    # Intervalo de 1 segundo
    default 1000 
    help
        Intervalo de repetição do timer em milissegundos.

endmenu
```
